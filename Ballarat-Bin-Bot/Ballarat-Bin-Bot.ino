// Ballarat Bin Bot by ObsoleteNerd (https://obsoletenerd.com/)
// Pulls rubbish truck data from the Ballarat.vic.gov.au API to tell you when to put which bins out for collection!
// Source: https://github.com/obsoletenerd/ballarat-bin-bot/

#include <Wire.h>
#include <HTTPClient.h>
#include <Adafruit_GFX.h>
#include <Adafruit_SSD1306.h>
#include <WiFiManager.h> // https://github.com/tzapu/WiFiManager
#include <ArduinoJson.h> // https://arduinojson.org/v6/example/parser/

// Edit the address after q= in this URL, making sure to put %20 wherever there's a space in your address
// eg: q=123%20High%20Street%20Sebastapol for "123 High Street Sebastapol"
const char *host = "https://data.ballarat.vic.gov.au/api/records/1.0/search/?sort=propnum&q=123%20High%20Street%20Sebastapol&rows=100&dataset=waste-collection-days&timezone=Australia/Melbourne&lang=en";

unsigned long timerDelay = 86400000; // 10000 = 10 seconds for testing, or timer set to 86400000 for daily in production

#define SCREEN_WIDTH 128 // OLED display width, in pixels
#define SCREEN_HEIGHT 64 // OLED display height, in pixels

// Declaration for an SSD1306 display connected to I2C (SDA, SCL pins)
Adafruit_SSD1306 display(SCREEN_WIDTH, SCREEN_HEIGHT, &Wire, -1);

// Splashscreen
static const uint8_t image_data_Saraarray[1024] = {
	0xff, 0xff, 0xff, 0xff, 0xff, 0xff, 0xff, 0xff, 0xff, 0xff, 0xff, 0xff, 0xff, 0xff, 0xff, 0xff, 
	0xff, 0xff, 0xff, 0xf9, 0xff, 0xff, 0xff, 0xff, 0xff, 0xff, 0xff, 0xff, 0xff, 0xff, 0xff, 0xff, 
	0xff, 0xff, 0xff, 0xe0, 0x7f, 0xff, 0xff, 0xff, 0xff, 0xff, 0xff, 0xff, 0xff, 0xff, 0xff, 0xff, 
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	0xff, 0xff, 0xff, 0xff, 0xff, 0xff, 0xff, 0xff, 0xff, 0xff, 0xff, 0xff, 0xff, 0xff, 0xff, 0xff
};
 
void setup() {
  Serial.begin(115200);
  
  // Initiate WifiManager
  WiFiManager wm;
  bool res;
  res = wm.autoConnect("BinBotAP","BinBotBestBot!"); // Setup AP if it can't find internet

  // Start I2C Communication SDA = 5 and SCL = 4 on Wemos Lolin32 ESP32 with built-in SSD1306 OLED
  Wire.begin(5, 4);

  if(!display.begin(SSD1306_SWITCHCAPVCC, 0x3C, false, false)) {
    Serial.println(F("SSD1306 allocation failed"));
    for(;;);
  }
  // Set the OLED display up for later
  display.clearDisplay();  
  display.setTextSize(1);
  display.setTextColor(WHITE);

  // Draw the splashscreen
  display.drawBitmap(0, 0, image_data_Saraarray, 128, 64, 1);
  display.display();

  delay(5000); // Let splashscreen show for a few seconds...

  display.clearDisplay();

  // Check for WiFi Connection
  if(!res) {
      Serial.println("Failed to connect to WiFi");

      display.setCursor(0, 10);
      // Display static text
      display.println("Failed to connect to WiFi");
      display.display(); 
  } 
  else {
      Serial.println("Connected to WiFi");

      display.setCursor(0, 10);
      display.println("Connected to Wifi");
      display.display(); 
  }
}
 
void loop() {
  HTTPClient http;

    Serial.print("Request URL: ");
    Serial.println(host);

    http.begin(host);
    int httpCode = http.GET(); // Send the HTTP GET request
    String payload = http.getString(); // Grab the payload

    Serial.print("HTTP Response Code:");
    Serial.println(httpCode); // Print http code to serial (200 = OK)

    Serial.print("Payload Received:");
    Serial.println(payload); // Print the raw payload to serial for debugging
    
    if(httpCode == 200)
    {
      display.clearDisplay();
      display.setCursor(0, 30);
      display.print("Processing Data...");
      display.display(); 

      // Allocate JsonBuffer (arduinojson.org/assistant)
      StaticJsonDocument<1024> doc;
      DeserializationError error = deserializeJson(doc, payload);

      // Test if parsing succeeds.
      if (error) {
        Serial.print(F("deserializeJson() failed: "));
        Serial.println(error.f_str());
        return;
      }
    
      // Extract values we need
      int addressFound = doc["nhits"]; // 1 = Yes, 0 = No
      JsonObject records_0 = doc["records"][0];
      JsonObject records_0_fields = records_0["fields"];
      const char* collectionDay = records_0_fields["collectionday"];
      const char* nextRecycle = records_0_fields["nextrecycle"]; // Format: "2023-03-02"
      const char* nextGreen = records_0_fields["nextgreen"]; // Format: "2023-02-23"
      const char* addressDetected = records_0_fields["address"];
      const char* nextRubbish = records_0_fields["nextwaste"]; // Format: "2023-02-23"
      
      display.clearDisplay();

      if (addressFound == 1) {
        // Print values to serial for debugging
        Serial.print("Next Recycle Bin: ");
        Serial.println(nextRecycle);
        Serial.print("Next Green Bin: ");
        Serial.println(nextGreen);
        Serial.print("Next Rubbish Bin: ");
        Serial.println(nextRubbish);

        // Display on OLED
        display.setCursor(0, 10);
        display.print("Rubbish: ");
        display.setCursor(60, 10);
        display.print(nextRubbish);

        display.setCursor(0, 30);
        display.print("Recycling: ");
        display.setCursor(60, 30);
        display.print(nextRecycle);

        display.setCursor(0, 50);
        display.print("Green: ");
        display.setCursor(60, 50);
        display.print(nextGreen);
      } else {
        display.setCursor(0, 30);
        display.print("Address Error!");
      }

        display.display(); 
    }
    else
    {
      Serial.println("Error in response: ");
      Serial.println(httpCode);

      // Display error on OLED
      display.clearDisplay();

      display.setCursor(0, 30);
      display.print("Error: ");
      display.print(httpCode);

      display.display(); 
    }

    http.end();
    delay(timerDelay);
}